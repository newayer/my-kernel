#include "rk3506-my-base.dtsi"

/ {
	chosen {
		bootargs = "earlycon=uart8250,mmio32,0xff0a0000 console=ttyFIQ0 root=PARTUUID=614e0000-0000 rootwait snd_aloop.index=7 snd_aloop.use_raw_jiffies=1";
	};
};

&mmc {
	status = "okay";
};
