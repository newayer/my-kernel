/*
 * Tronlong i.MX6ULL core board - eMMC version
 */

/dts-v1/;

#include "my-imx6ull-base.dtsi"

/ {
	model = "Tronlong i.MX6ULL Core Board (eMMC)";
	compatible = "fsl,imx6ull-14x14-evk", "fsl,imx6ull";
};

&usdhc2 {
	status = "okay";
};
